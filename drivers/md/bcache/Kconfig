## drivers/md/bcache/Kconfig
```kconfig
config BCACHE
	tristate "Block device as cache"
	select COMPACTION
	select LIBCRC32C
	select CRYPTO_SHA1
	select FS_POSIX_ACL
	select LZ4_COMPRESS
	select LZ4_DECOMPRESS
	select ZLIB_DEFLATE
	select ZLIB_INFLATE
	select CRYPTO_SHA256
	---help---
	Allows a block device to be used as cache for other devices; uses
	a btree for indexing and the layout is optimized for SSDs.

	See Documentation/bcache.txt for details.

config BCACHE_DEBUG
	bool "Bcache debugging"
	depends on BCACHE
	---help---
	Don't select this option unless you're a developer

	Enables extra debugging tools, allows expensive runtime checks to be
	turned on.

config BCACHE_CLOSURES_DEBUG
	bool "Debug closures"
	depends on BCACHE
	select DEBUG_FS
	---help---
	Keeps all active closures in a linked list and provides a debugfs
	interface to list them, which makes it possible to see asynchronous
	operations that get stuck.

config BCACHE_NO_IO
	bool "Disable IO to underlying device"
	depends on BCACHE
	---help---
	Stubs out all the actual IO calls
```
